## conf/distro/webkitdevci.conf
```bitbake
# Distro based on Poky
require conf/distro/poky.conf

DISTRO = "webkitdevci"
DISTRO_NAME= "WebKit Dev@CI (Yocto Poky Based Distro)"

# Expand inmediately (:=) this two variables as soon as they are assigned (now),
# otherwise the (default) lazy expansion causes issues with BASEFILESISSUEINSTALL
# at recipe 'base-files' due to 'metadata not deterministic' errors.
# This two environment variables are automatically set by the script 'cross-toolchain-helper'
# of WebKit. The purpose of them is to define into the image in the file /etc/os-release
# the target pretty name and an unique version identifier of the image.
# In case of building this recipe outside of the environment created by the script
# 'cross-toolchain-helper' then this identifiers will default to the machine name
# as defined in local.conf and the current date string.
# This information is useful to detect when the image that is running on a board like a WPE
# RPi performance bot doesn't match the version that should be running (as calculated from
# the sources of the image definition of the WebKit checkout).
# For more details about this see: https://bugs.webkit.org/show_bug.cgi?id=249031
WEBKIT_CROSS_TARGET := "${@d.getVar('BB_ORIGENV').getVar('WEBKIT_CROSS_TARGET') or '${MACHINE}'}"
WEBKIT_CROSS_VERSION := "${@d.getVar('BB_ORIGENV').getVar('WEBKIT_CROSS_VERSION') or '${DATE}'}"

DISTRO_NAME:append = " [target ${WEBKIT_CROSS_TARGET}]"
DISTRO_VERSION:append = "_${WEBKIT_CROSS_VERSION}"

DISTROOVERRIDES:append = " poky:linuxstdbase"

# Distro features
DISTRO_FEATURES:append = " opengl egl pam systemd usrmerge polkit"
DISTRO_FEATURES:remove = "ptest"
DISTRO_FEATURES_NATIVESDK:append = " wayland"

# Use systemd
DISTRO_FEATURES_BACKFILL_CONSIDERED = "sysvinit"
VIRTUAL-RUNTIME_init_manager = "systemd"
VIRTUAL-RUNTIME_dev_manager = "systemd"

# Add the GDB Text User Interface (TUI) terminal interface
PACKAGECONFIG:append:pn-gdb = " tui"
PACKAGECONFIG:append:pn-gdb-cross = " tui"
PACKAGECONFIG:append:pn-gdb-cross-canadian = " tui"

# Don't blank the screen on weston, and build the rdp backend
PACKAGECONFIG:append:pn-weston = " rdp"
PACKAGECONFIG:append:pn-weston-init = " no-idle-timeout"
# Enable php plugins for apache (for tests)
PACKAGECONFIG:append:pn-php = " apache2"
# Disable mysql support as we don't need to build mysql/mariadb
PACKAGECONFIG:remove:pn-php = "mysql"

# Whitelist license from some deps.
LICENSE_FLAGS_ACCEPTED:append = " commercial synaptics-killswitch"
```

## conf/layer.conf
```bitbake
# We have a conf and classes directory, append to BBPATH
BBPATH .= ":${LAYERDIR}"

# We have a recipes directory, add to BBFILES
BBFILES += "${LAYERDIR}/recipes-*/*/*.bb ${LAYERDIR}/recipes-*/*/*.bbappend"

BBFILES_DYNAMIC += " \
    qt5-layer:${LAYERDIR}/dynamic-layers/qt5-layer/*/*/*.bb \
    qt5-layer:${LAYERDIR}/dynamic-layers/qt5-layer/*/*/*.bbappend \
    "

BBFILE_COLLECTIONS += "webkit"
BBFILE_PATTERN_webkit := "^${LAYERDIR}/"
BBFILE_PRIORITY_webkit = "7"

# do not error out on bbappends for missing recipes
BB_DANGLINGAPPENDS_WARNONLY = "true"

# Support from the current actively maintained LTS Yocto release
LAYERSERIES_COMPAT_webkit = "kirkstone langdale mickledore nanbield"
```
